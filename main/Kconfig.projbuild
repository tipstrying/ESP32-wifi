## main/Kconfig.projbuild
```kconfig
menu "Example Configuration"

config WIFI_SSID
    string "WiFi SSID"
    default "wpa2_test"
    help
        SSID (network name) for the example to connect to.
config WIFI_PASSWORD
    string "WIFI PASSWORD"
    default "none"
    help
        PASSWORD for the example SSID to connect to.
config STATIC_IP_ENABLE
    bool "static ip enable"
    default y
    help
        DHCPCD Set.
config STATIC_IP
    string "IP"
    depends on STATIC_IP_ENABLE
    default "192.168.0.97"
config STATIC_NETMASK
    string "NETMASK"
    depends on STATIC_IP_ENABLE
    default "255.255.255.0"
config STATIC_GATEWAY
    string "GateWay"
    depends on STATIC_IP_ENABLE
    default "192.168.0.1"

config EAP_METHOD
    int "EAP METHOD"
    default 1
    help
        EAP method (TLS, PEAP or TTLS) for the example to use.
        TLS: 0, PEAP: 1, TTLS: 2
		
config EAP_ID
    string "EAP ID"
    default "example@espressif.com"
    help
        Identity in phase 1 of EAP procedure.
        
config EAP_USERNAME
    string "EAP USERNAME"
    default "espressif"
    help
        Username for EAP method (PEAP and TTLS).
        
config EAP_PASSWORD
    string "EAP PASSWORD"
    default "test11"
    help
        Password for EAP method (PEAP and TTLS).

endmenu
```
